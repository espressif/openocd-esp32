/* SPDX-License-Identifier: Apache-2.0 OR MIT */
/* SPDX-FileCopyrightText: 2025 Espressif Systems (Shanghai) CO LTD */

MEMORY {
	iram : org = 0x2F000000, len = 0x1000
	dram : org = 0x2F001000, len = 0x1000
}
