/* SPDX-License-Identifier: Apache-2.0 OR MIT */
/* SPDX-FileCopyrightText: 2025 Espressif Systems (Shanghai) CO LTD */

MEMORY {
	iram : org = 0x8FF80000, len = 0x1000
	dram : org = 0x8FF81000, len = 0x1000
}
