/* SPDX-License-Identifier: Apache-2.0 OR MIT */
/* SPDX-FileCopyrightText: 2026 Espressif Systems (Shanghai) CO LTD */

MEMORY {
	iram : org = 0x40800000, len = 0xC00
	dram : org = 0x40800C00, len = 0x400
}
