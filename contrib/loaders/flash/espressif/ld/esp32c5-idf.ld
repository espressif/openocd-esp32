/* SPDX-License-Identifier: Apache-2.0 OR MIT */
/* SPDX-FileCopyrightText: 2025 Espressif Systems (Shanghai) CO LTD */

MEMORY {
	iram : org = 0x40800000, len = 0x1000
	dram : org = 0x40801000, len = 0x1000
}
