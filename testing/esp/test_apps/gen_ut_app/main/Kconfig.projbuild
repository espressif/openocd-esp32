## testing/esp/test_apps/gen_ut_app/main/Kconfig.projbuild
```kconfig
menu "Unit test application configuration"

config BLINK_GPIO
    int "Blink GPIO number"
	range 0 34
    default 5 if IDF_TARGET_ESP32
    default 18 if IDF_TARGET_ESP32S2
    default 48 if IDF_TARGET_ESP32S3
    default 8
	help
		GPIO number (IOxx) to blink on and off.

		Some GPIOs are used for other purposes (flash connections, etc.) and cannot be used to blink.

		GPIOs 35-39 are input-only so cannot be used as outputs.

config GEN_UT_APP_CUSTOM_LD_FILENAME
    string "Custom LD script file"
    default ""
    help
        Name of the custom LD script filename. This path is evaluated
        relative to the project root directory.

config GEN_UT_APP_RUNTEST
    int "Set test number to run"
    default 0
    help
        A test with the selected number will be executed unless the testing
        system will not overwrite the value.

endmenu
```
